## boards/IMYTH/BLETracker/BLETracker_defconfig
```kconfig
# Copyright (C) 2026 Lancelot MEI
# SPDX-License-Identifier: GPL-2.0-only

# Enable MPU
CONFIG_ARM_MPU=y

# Enable hardware stack protection
CONFIG_HW_STACK_PROTECTION=y

# Enable RTT
CONFIG_USE_SEGGER_RTT=y

# enable GPIO
CONFIG_GPIO=y

# enable uart driver
CONFIG_SERIAL=y

# enable console
CONFIG_CONSOLE=y
CONFIG_UART_CONSOLE=n

CONFIG_I2C=y
CONFIG_ADC=y
```

## boards/IMYTH/BLETracker/Kconfig.BLETracker
```kconfig
# Copyright (C) 2026 Lancelot MEI
# SPDX-License-Identifier: GPL-2.0-only

config BOARD_BLETRACKER
	select SOC_NRF52840_QIAA
```

## boards/IMYTH/BLETracker/board.yml
```yaml
# Copyright (C) 2026 Lancelot MEI
# SPDX-License-Identifier: GPL-2.0-only

board:
  name: BLETracker
  vendor: IMYTH
  socs:
    - name: nrf52840
```
